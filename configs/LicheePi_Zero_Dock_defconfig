## configs/LicheePi_Zero_Dock_defconfig
```kconfig
CONFIG_ARM=y
CONFIG_ARCH_SUNXI=y
CONFIG_SPL=y
CONFIG_MACH_SUN8I_V3S=y
CONFIG_DEFAULT_DEVICE_TREE="sun8i-v3s-licheepi-zero-dock"
```

## configs/S3-OLinuXino_defconfig
```kconfig
CONFIG_ARM=y
CONFIG_ARCH_SUNXI=y
CONFIG_SPL=y
CONFIG_MACH_SUN8I_V3=y
CONFIG_DRAM_ODT_EN=y
CONFIG_CONS_INDEX=2
CONFIG_DEFAULT_DEVICE_TREE="sun8i-s3-olinuxino"
CONFIG_SPL_I2C_SUPPORT=y
```

## configs/sl631_imx179_defconfig
```kconfig
CONFIG_ARM=y
CONFIG_ARCH_SUNXI=y
CONFIG_SPL=y
CONFIG_MACH_SUN8I_V3=y
CONFIG_DRAM_ODT_EN=y
CONFIG_CONS_INDEX=2
CONFIG_DEFAULT_DEVICE_TREE="sun8i-v3-sl631-imx179"
CONFIG_AXP_ALDO3_VOLT=2800
CONFIG_AXP_ALDO3_INRUSH_QUIRK=y
CONFIG_SPL_I2C_SUPPORT=y
CONFIG_USB_MUSB_GADGET=y
CONFIG_SYS_USB_EVENT_POLL_VIA_INT_QUEUE=y
CONFIG_FASTBOOT=y
```
